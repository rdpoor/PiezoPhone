/*
 * xylophone_synth.ino
 * ===================
 * Struck-bar idiophone synthesizer for the Arduino Nano R4.
 *
 * Hardware
 * --------
 *   A0        — DAC output → coupling cap → power amp → speaker
 *   A1 – A7   — Piezo sensors (1 kΩ series + 1N5819 clamp diodes each)
 *
 * Architecture
 * ------------
 *   A 16 kHz timer ISR sums 7 voices × 3 partials = 21 damped-sine
 *   oscillators per sample and writes the result to the 12-bit DAC.
 *   Each oscillator uses the second-order IIR recurrence:
 *
 *       x[n] = coeff·x[n-1] − rho2·x[n-2]
 *
 *   with coefficients precomputed in tones.h (generated by gen_tones.py).
 *   The foreground loop runs a per-sensor peak detector; on trigger it
 *   resets the appropriate voice using noInterrupts() for atomic update.
 *
 * Usage
 * -----
 *   1. Run:  python3 gen_tones.py > tones.h
 *   2. Place tones.h in the same folder as this sketch.
 *   3. Edit SENSOR_NOTE[] to map each sensor to a desired pitch.
 *   4. Compile and upload via Arduino IDE (board: Arduino Nano R4).
 */

#include "FspTimer.h"
#include "tones.h"

// ── Tuning constants ───────────────────────────────────────────────────────────

static const int   SAMPLE_RATE  = 22050;  // Hz — must match gen_tones.py
static const int   NUM_VOICES   = 7;
static const int   DAC_CENTER   = 2048;   // 12-bit mid-scale

// Scale factor from the floating-point sum to DAC counts.
// Single full-amplitude voice peaks at ~1.63 units; OUTPUT_GAIN = 500
// gives ~815 counts of swing — comfortable headroom for 2–3 simultaneous
// strikes. Increase for louder output; reduce if clipping distortion occurs.
static const float OUTPUT_GAIN  = 500.0f;

// Peak detector parameters (14-bit ADC, range 0–16383)
static const int   NOISE_FLOOR  = 6000;   // ignore signals below this level
static const int   MIN_FALL     = 200;    // min drop from peak to confirm strike
static const int   HOLDOFF_MS   = 50;     // ms dead-time after each trigger

// ── Sensor → note mapping ──────────────────────────────────────────────────────
// Edit these to assign pitches to physical sensor positions.
// All valid IDs are listed in the NoteID enum in tones.h (NOTE_C4 … NOTE_B5).

static const int SENSOR_PINS[NUM_VOICES] = {
    A1, A2, A3, A4, A5, A6, A7
};

static const NoteID SENSOR_NOTE[NUM_VOICES] = {
    NOTE_C5, NOTE_D5, NOTE_E5, NOTE_F5, NOTE_G5, NOTE_A5, NOTE_B5
};

// ── Data structures ────────────────────────────────────────────────────────────

struct PartialState {
    float x1;   // x[n-1]  (most recent output)
    float x2;   // x[n-2]
};

struct Voice {
    PartialState     partials[NUM_PARTIALS];
    const NoteCoeff* note;    // pointer into NOTE_TABLE (set at trigger)
};

// ── Globals ────────────────────────────────────────────────────────────────────

static Voice    voices[NUM_VOICES];
static FspTimer audio_timer;

// ── Audio ISR — runs at SAMPLE_RATE Hz ────────────────────────────────────────
//
// Inner loop cost per sample:
//   7 voices × 3 partials × (2 muls + 1 sub + 1 add) = 84 float ops.
// At 48 MHz with the Cortex-M4 FPU this takes well under 10 µs,
// leaving >80% of the CPU available to the foreground loop.

void audio_isr(timer_callback_args_t __attribute__((unused)) *p_args) {
    digitalWrite(D2, HIGH);   // ISR entry — connect scope to D2
    float sum = 0.0f;

    for (int v = 0; v < NUM_VOICES; v++) {
        const NoteCoeff* nc = voices[v].note;
        PartialState*    ps = voices[v].partials;
        for (int p = 0; p < NUM_PARTIALS; p++) {
            // Load state into locals so the compiler keeps them in registers (maybe).
            float x1    = ps[p].x1;
            float x2    = ps[p].x2;

            // Advance recurrence.
            float x_new = nc->partials[p].coeff * x1
                        - nc->partials[p].rho2  * x2;
            ps[p].x2 = x1;
            ps[p].x1 = x_new;

            // Emit the sample we just shifted out (x1 before the update).
            // Amplitude is already baked into x2 via the trigger seed.
            sum += x1;
        }
    }

    // Map to 12-bit DAC range with hard clip.
    int32_t dac = DAC_CENTER + (int32_t)(OUTPUT_GAIN * sum);
    if (dac <    0) dac =    0;
    if (dac > 4095) dac = 4095;

    R_DAC->DADR[0] = (uint16_t)dac;   // direct register write — ISR safe
    digitalWrite(D2, LOW);   // ISR exit
}

// ── Voice trigger ──────────────────────────────────────────────────────────────
//
// Called from the foreground when a peak is detected.
// noInterrupts() ensures the ISR never sees a partially-updated voice.

void trigger_voice(int voice_idx, float strike_amp) {
    const NoteCoeff* nc = &NOTE_TABLE[SENSOR_NOTE[voice_idx]];

    noInterrupts();
    voices[voice_idx].note = nc;
    for (int p = 0; p < NUM_PARTIALS; p++) {
        voices[voice_idx].partials[p].x1 = 0.0f;
        voices[voice_idx].partials[p].x2 = strike_amp * nc->partials[p].seed;
    }
    interrupts();
}

// ── Setup ──────────────────────────────────────────────────────────────────────

void setup() {
    Serial.begin(115200);

    // D2 is used for timing the ISR
    pinMode(D2, OUTPUT);

    // DAC: 12-bit resolution, centred at mid-scale.
    analogWriteResolution(12);
    analogWrite(A0, DAC_CENTER);

    // ADC: 14-bit resolution for maximum sensor sensitivity.
    analogReadResolution(14);

    // Initialise all voices to silence (zero state, pointing at their
    // assigned note so the ISR never dereferences a null pointer).
    for (int v = 0; v < NUM_VOICES; v++) {
        voices[v].note = &NOTE_TABLE[SENSOR_NOTE[v]];
        for (int p = 0; p < NUM_PARTIALS; p++) {
            voices[v].partials[p].x1 = 0.0f;
            voices[v].partials[p].x2 = 0.0f;
        }
    }

    // Start the audio timer ISR.
    // Try GPT first (higher resolution); fall back to AGT if unavailable.
    uint8_t timer_type = GPT_TIMER;
    int8_t  timer_ch   = FspTimer::get_available_timer(timer_type);
    if (timer_ch < 0) {
        timer_type = AGT_TIMER;
        timer_ch   = FspTimer::get_available_timer(timer_type);
    }
    if (timer_ch < 0) {
        // No timer available — halt with a diagnostic message.
        while (true) {
            Serial.println("ERROR: no timer available for audio ISR");
            delay(2000);
        }
    }

    audio_timer.begin(TIMER_MODE_PERIODIC, timer_type, timer_ch,
                      (float)SAMPLE_RATE, 0.0f, audio_isr);
    audio_timer.setup_overflow_irq();
    audio_timer.open();
    audio_timer.start();

    Serial.println("Xylophone ready.");
}

// ── Foreground loop — peak detector ───────────────────────────────────────────

enum SensorPhase { IDLE, RAMPING_UP, AT_MAX, HOLDOFF, DRAINING };

struct SensorState {
    SensorPhase   phase;          // zero-initialised → IDLE
    int           peak;
    unsigned long holdoff_until;
};

static SensorState sensors[NUM_VOICES];

void loop() {
    for (int v = 0; v < NUM_VOICES; v++) {
        int val = analogRead(SENSOR_PINS[v]);
        SensorState& s = sensors[v];

        switch (s.phase) {

            case IDLE:
                if (val > NOISE_FLOOR) {
                    s.peak  = val;
                    s.phase = RAMPING_UP;
                }
                break;

            case RAMPING_UP:
                if (val > s.peak) {
                    s.peak = val;
                } else if (s.peak - val > MIN_FALL) {
                    s.phase = AT_MAX;
                }
                break;

            case AT_MAX:
                trigger_voice(v, (float)s.peak / 16383.0f);
                Serial.print("trigger v");
                Serial.print(v);
                Serial.print("  peak=");
                Serial.println(s.peak);
                s.holdoff_until = millis() + HOLDOFF_MS;
                s.phase = HOLDOFF;
                break;

            case HOLDOFF:
                if (millis() >= s.holdoff_until) {
                    s.phase = DRAINING;
                }
                break;

            case DRAINING:
                if (val <= NOISE_FLOOR) {
                    s.peak  = 0;
                    s.phase = IDLE;
                }
                break;
        }
    }
}